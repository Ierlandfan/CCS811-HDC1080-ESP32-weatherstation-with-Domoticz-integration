/*

    2018 - Vortecks
    IT IS RECOMMENDED THAT YOU LEAVE THE CO2/TVOC MODULE RUNNING FOR 48 HOURS BEFORE USE
    THIS IS ONLY A REFERENCE DEVICE AND IS NOT A REPLACEMENT FOR A CALIBRATED UNIT. PLEASE DO NOT USE IT FOR SITUATIONS WHERE YOUR HEALTH/SAFETY MAY BE AT RISK

    Safe levels of CO2 & TVOC:
    _______________________________________________________________________________________________________________________________________________________________________
    CO2 (equivalent calculated carbon-dioxide)
    350-1,000ppm                   Concentrations typical of occupied indoor spaces with good air exchange
    1,000-2,000ppm                 Complaints of drowsiness and poor air.
    2,000-5,000 ppm                Headaches, sleepiness and stagnant, stale, stuffy air. Poor concentration, loss of attention, increased heart rate and slight nausea may also be present.

    _______________________________________________________________________________________________________________________________________________________________________
    TVOC (Total Volatile Organic Compound)
    If TVOCs are present, an overall concentration will be reported. While there are no exposure limits for TVOCs some guidelines have been recommended. Generally, TVOC concentrations between 50 parts per billion (ppb) and 325 ppb are thought to be acceptable

    Household product which emit TVOC:
    Paints, paint strippers and other solvents, wood preservatives, aerosol sprays, cleansers and disinfectants, moth repellents and air fresheners, stored fuels and automotive products, hobby supplies, dry-cleaned clothing, pesticide, other products, including:

    Building materials and furnishings which emit TVOC:
    Office equipment such as copiers and printers, correction fluids and carbonless copy paper, graphics and craft materials including glues and adhesives, permanent markers and photographic solutions.
    _______________________________________________________________________________________________________________________________________________________________________
   2019- Modified by Ierlandfan to send Temp/Humid C02 and VOC values to Domoticz so it can be used as a standalone sensor without display. 
   

    ********************************************************************************************************************************************************
                                                                      Change the following to suit
    ********************************************************************************************************************************************************
*/
const char*     ssid     = "YOUR-SSID";              // The SSID of your network
const char*     password = "YOUR-PASSWORD";           // The password of your network
#define         Weather_interval 900000               // How many milliseconds for weather update - 900000 = 15mins (1000x60x15)
const char*     ntpServer = "pool.ntp.org";           // The URL of the time server
const long      gmtOffset_sec = 0;                    // How many seconds offset from GMT
const int       daylightOffset_sec = 3600;            // Adjust for BST/DST - In the UK, BST should be zero, winter should be 3600
const bool      PWS = true;                           // Use PWS (Personal Weather Station) to gather weather data or use 'Country' and 'City'. If PWS = true, the country & city are ignored
const String    PWSLocation = "pws:IOLDBURY2";        // Wunderground station ID - These usually have to start with PWS: (e.g. Tividale pws:IOLDBURY2 Hednesford pws:IHEDNESF2)
const String    apikey   = "YOUR_WUNDERGROUND_KEY" ;  // Your Wunderground API key
const String    country  = "UK";                      // Your country - Not needed if you use a PWS code
const String    city     = "Hednesford";              // Your city - Not needed if you use a PWS code
const float     TempOffset = -6.5;                    // Offset for internal temperature
const float     HumOffset = 10;                       // Offset for internal humidity
const int       CO2Trigger = 2000;                    // Trigger level for CO2 - 350-1,000ppm is considered acceptable
const int       TVOCTrigger = 325;                    // Trigger level for TVOC - Between 50 parts per billion (ppb) and 325 ppb is considered acceptable
const bool      returnAfterAlarm = true;              // When an alarm is triggered (CO2 or TVOC) should if be cancelled when readings return to normal? (false = stay on alarm, true = return to normal)
const bool      degreesC = true;                      // Display degrees C (True) or degrees F (False)
const bool      windMPH = true;                       // Display wind in MPH (True) or KPH (False)
const int       buzzerPin = 27;                       // The buzzer pin number
/* domoticz specific values */
const char * domoticz_server = "192.168.1.100"; //Domoticz IP
int port = 8080; //Domoticz port
int idx1 = 5; //IDX for virtual sensor, found in Setup -> Devices //Co2
int idx2 = 5; //IDX for virtual sensor, found in Setup -> Devices //Temp
int idx3 = 5; //IDX for virtual sensor, found in Setup -> Devices // Humidity
int idx4 = 5; //IDX for virtual sensor, found in Setup -> Devices //Spare
int idx5 = 5; //IDX for virtual sensor, found in Setup -> Devices //Spare
/*
    ********************************************************************************************************************************************************
                                                           Do not change anything below this point
    ********************************************************************************************************************************************************
*/

#include <elapsedMillis.h>    // https://github.com/pfeerick/elapsedMillis
#include <ArduinoJson.h>      // https://github.com/bblanchon/ArduinoJson
#include <U8g2lib.h>          // https://github.com/olikraus/u8g2
#include <WiFi.h>
#include <SPI.h>
#include "time.h"
#include "driver/spi_master.h"
#include "Adafruit_CCS811.h"

#define icon_width  50
#define icon_height 50

const char* host = "api.wunderground.com";
const int icon_x = 102; // X position of weather icon
const int icon_y = 12; // Y position of weather icon
int TVOC = 0;
int CO2 = 0;
bool initboot = true;
Adafruit_CCS811 ccs;
elapsedMillis timer0;
WiFiClient client;
String currCondString;
String icon;
String CurrTemp;
String CurrWindDir;
String CurrPress;
String CurrWeather;
String CurrHumd;
String CurrWind;
String CurrTrend;

U8G2_SSD1322_NHD_256X64_F_4W_HW_SPI u8g2(U8G2_R0, /* cs=*/ 0, /* dc=*/ 32, /* reset=*/ 19);  // Enable U8G2_16BIT in u8g2.h

// Define each of the weather icons
const uint8_t snow_icon[] PROGMEM = {
  0x00, 0x00, 0x00, 0x00, 0x00, 0x00, 0x00, 0x00, 0x00, 0x00, 0x00, 0x00,
  0x00, 0x00, 0x00, 0x00, 0x00, 0x00, 0x00, 0x00, 0x00, 0x00, 0x00, 0x00,
  0x00, 0x00, 0x00, 0x00, 0x00, 0x00, 0x00, 0x00, 0x00, 0x00, 0x00, 0x00,
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  0x00, 0x00,
};

const uint8_t rain_icon[] PROGMEM = {
  0x00, 0x00, 0x00, 0x00, 0x00, 0x00, 0x00, 0x00, 0x00, 0x00, 0x00, 0x00,
  0x00, 0x00, 0x00, 0x00, 0x00, 0x00, 0x00, 0x00, 0x00, 0x00, 0x00, 0x00,
  0x00, 0x00, 0x00, 0x00, 0x00, 0x00, 0x00, 0x00, 0x00, 0x00, 0x00, 0x00,
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  0x00, 0x00,
};

const uint8_t sleet_icon[] PROGMEM = {
  0x00, 0x00, 0x00, 0x00, 0x00, 0x00, 0x00, 0x00, 0x00, 0x00, 0x00, 0x00,
  0x00, 0x00, 0x00, 0x00, 0x00, 0x00, 0x00, 0x00, 0x00, 0x00, 0x00, 0x00,
  0x00, 0x00, 0x00, 0x00, 0x00, 0x00, 0x00, 0x00, 0x00, 0x00, 0x00, 0x00,
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  0x00, 0x00,
};

const uint8_t sunny_icon[] PROGMEM = {
  0x00, 0x00, 0x00, 0x00, 0x00, 0x00, 0x00, 0x00, 0x00, 0x00, 0x00, 0x00,
  0x00, 0x00, 0x00, 0x00, 0x00, 0x00, 0x00, 0x00, 0x00, 0x00, 0x00, 0x00,
  0x01, 0x00, 0x00, 0x00, 0x00, 0x00, 0x04, 0x41, 0x00, 0x00, 0x00, 0x00,
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  0x00, 0x00,
};

const uint8_t cloudy_icon[] PROGMEM = {
  0x00, 0x00, 0x00, 0x00, 0x00, 0x00, 0x00, 0x00, 0x00, 0x00, 0x00, 0x00,
  0x00, 0x00, 0x00, 0x00, 0x00, 0x00, 0x00, 0x00, 0x00, 0x00, 0x00, 0x00,
  0x00, 0x00, 0x00, 0x00, 0x00, 0x00, 0x00, 0x00, 0x00, 0x00, 0x00, 0x00,
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  0x00, 0x00,
};

const uint8_t mostlysunny_icon[] PROGMEM = {
  0x00, 0x00, 0x00, 0x00, 0x00, 0x00, 0x00, 0x00, 0x00, 0x00, 0x00, 0x00,
  0x00, 0x00, 0x00, 0x00, 0x00, 0x00, 0x00, 0x00, 0x00, 0x00, 0x00, 0x00,
  0x00, 0x00, 0x00, 0x00, 0x00, 0x00, 0x00, 0x00, 0x00, 0x00, 0x00, 0x00,
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  0x00, 0x00,
};

const uint8_t fog_icon[] PROGMEM = {
  0x00, 0x00, 0x00, 0x00, 0x00, 0x00, 0x00, 0x00, 0x00, 0x00, 0x00, 0x00,
  0x00, 0x00, 0x00, 0x00, 0x00, 0x00, 0x00, 0x00, 0x00, 0x00, 0x00, 0x00,
  0x00, 0x00, 0x00, 0x00, 0x00, 0x00, 0x00, 0x00, 0x00, 0x00, 0x00, 0x00,
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  0x00, 0x00,
};

const uint8_t tstorms_icon[] PROGMEM = {
  0x00, 0x00, 0x00, 0x00, 0x00, 0x00, 0x00, 0x00, 0x00, 0x00, 0x00, 0x00,
  0x00, 0x00, 0x00, 0x00, 0x00, 0x00, 0x00, 0x00, 0x00, 0x00, 0x00, 0xFC,
  0x01, 0x00, 0x00, 0x00, 0x00, 0x00, 0xFF, 0x07, 0x00, 0x00, 0x00, 0x00,
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  0x00, 0x00,
};

const uint8_t nt_mostlycloudy_icon[] PROGMEM = {
  0x00, 0x00, 0x00, 0x00, 0x00, 0x00, 0x00, 0x00, 0x00, 0x00, 0x00, 0x00,
  0x00, 0x00, 0x00, 0x00, 0x00, 0x00, 0x00, 0x00, 0x00, 0x00, 0x00, 0x00,
  0x00, 0x00, 0x00, 0x00, 0x00, 0x00, 0x00, 0x00, 0x00, 0x00, 0x00, 0x00,
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  0x00, 0x00,
};

const uint8_t nt_clear_icon[] PROGMEM = {
  0x00, 0x00, 0x00, 0x00, 0x00, 0x00, 0x00, 0x00, 0x00, 0x00, 0x00, 0x00,
  0x00, 0x00, 0x00, 0x00, 0x00, 0x00, 0x00, 0x00, 0x00, 0x00, 0x00, 0x00,
  0x00, 0x00, 0x00, 0x00, 0x00, 0x00, 0x00, 0x00, 0x00, 0x00, 0x00, 0x00,
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  0x00, 0x00,
};

void setup() {
  Serial.begin(115200);
  pinMode(buzzerPin, OUTPUT);
  ccs.begin();
  Wire.begin();
  SPI.begin(14, 12, 13, 33);
  u8g2.begin();

  //Configure HDC1080
  Wire.beginTransmission(0x40);
  Wire.write(0x02);
  Wire.write(0x90);
  Wire.write(0x00);
  Wire.endTransmission();
  delay(20);

  u8g2.clearBuffer();
  timer0 = 0; // Init timer 0
  Start_WiFi(ssid, password);
  u8g2.clearBuffer();
}

void loop() {

  if (timer0 > Weather_interval || initboot) // Do the following if mills > interval  or initboot = true
  {
    initboot = false; // Set initial boot to false because it's already run
    //init and get the time
    configTime(gmtOffset_sec, daylightOffset_sec, ntpServer);
    timer0 = 0;                                 // Reset timer to zero
    Call_API(&currCondString); // Get data with an API call and place response in a String
    Serial.println(currCondString);   // Display the response
    if (CurrCondObj(&currCondString)) {
      icon = getWeatherIcon();
      if (degreesC)
        CurrTemp = getCurrC();
      else
        CurrTemp = getCurrF();
      CurrPress = getPressure_mb();
      CurrWeather = getCurrWeather();
      CurrHumd = getRelHum();
      if (windMPH)
        CurrWind = getWindMPH();
      else
        CurrWind = getWindKPH();
      CurrTrend = getPressure_trend();
    }
  }
  u8g2.clearBuffer();

  if (icon == "snow" ||
      icon == "chanceflurries" ||
      icon == "chancesnow" ||
      icon == "flurries" ||
      icon == "nt_chanceflurries" ||
      icon == "nt_chancesnow" ||
      icon == "nt_flurries" ||
      icon == "nt_snow")
    u8g2.drawXBMP(icon_x, icon_y, 50, 50, snow_icon);

  if (icon == "rain" ||
      icon == "chancerain" ||
      icon == "nt_chancerain" ||
      icon == "nt_rain")
    u8g2.drawXBMP(icon_x, icon_y, 50, 50, rain_icon);

  if (icon == "sleet" ||
      icon == "chancesleet" ||
      icon == "nt_chancesleet" ||
      icon == "nt_sleet")
    u8g2.drawXBMP(icon_x, icon_y, 50, 50, sleet_icon);

  if (icon == "sunny" ||
      icon == "clear")
    u8g2.drawXBMP(icon_x, icon_y, 50, 50, sunny_icon);

  if (icon == "cloudy" ||
      icon == "nt_cloudy")
    u8g2.drawXBMP(icon_x, icon_y, 50, 50, cloudy_icon);

  if (icon == "mostlysunny" ||
      icon == "partlycloudy" ||
      icon == "partlysunny" ||
      icon == "mostlycloudy")
    u8g2.drawXBMP(icon_x, icon_y, 50, 50, mostlysunny_icon);

  if (icon == "fog" ||
      icon == "nt_fog" ||
      icon == "nt_hazy" ||
      icon == "hazy")
    u8g2.drawXBMP(icon_x, icon_y, 50, 50, fog_icon);

  if (icon == "tstorms" ||
      icon == "chancetstorms" ||
      icon == "nt_tstorms" ||
      icon == "nt_chancetstorms")
    u8g2.drawXBMP(icon_x, icon_y, 50, 50, tstorms_icon);

  if (icon == "nt_mostlycloudy" ||
      icon == "nt_mostlysunny" ||
      icon == "nt_partlycloudy" ||
      icon == "nt_partlysunny")
    u8g2.drawXBMP(icon_x, icon_y, 50, 50, nt_mostlycloudy_icon);

  if (icon == "nt_clear")
    u8g2.drawXBMP(icon_x, icon_y, 50, 50, nt_clear_icon);

  displayData();

  u8g2.sendBuffer();

}

int Start_WiFi(const char* ssid, const char* password) {
  u8g2.setFont(u8g2_font_profont15_mf);

  int spacing = u8g2.getStrWidth(ssid);
  u8g2.setCursor(78 - (spacing / 2), 35);
  u8g2.print("Connecting to ");
  u8g2.print(ssid);
  int connAttempts = 0;
  Serial.println("\r\nConnecting to: " + String(ssid));
  WiFi.begin(ssid, password);
  u8g2.setCursor(20, 50);

  while (WiFi.status() != WL_CONNECTED ) {
    delay(500);
    Serial.print(".");
    u8g2.print(".");
    u8g2.sendBuffer();
    while (connAttempts > 30) // If connection to WiFi fails, do this for ever
    {
      u8g2.clearBuffer();
      u8g2.setFont(u8g2_font_profont15_mf);
      int spacing = u8g2.getStrWidth(ssid);
      u8g2.setCursor(53 - (spacing / 2), 35);
      u8g2.print("Connection to ");
      u8g2.print(ssid);
      u8g2.print(" failed");
      u8g2.sendBuffer();
    }
    connAttempts++;
  }

  Serial.println("WiFi connected\r\n");
  Serial.print("IP address: ");
  Serial.println(WiFi.localIP());
  return 1;
}

int Call_API(String* resultString) {
  client.stop();  // Clear any current connections
  Serial.println("Connecting to " + String(host)); // start a new connection
  const int httpPort = 80;
  if (!client.connect(host, httpPort)) {
    Serial.println("Connection failed");
    return false;
  }
  String url;
  if (PWS)
    url = "http://api.wunderground.com/api/" + apikey + "/conditions/q/" + PWSLocation + ".json";
  else
    url = "http://api.wunderground.com/api/" + apikey + "/conditions/q/" + country + "/" + city + ".json";

  Serial.println("Requesting URL: " + String(url));
  client.print(String("GET ") + url + " HTTP/1.1\r\n" +
               "Host: " + host + "\r\n" +
               "Connection: close\r\n\r\n");
  unsigned long timeout = millis();
  while (client.available() == 0) {
    if (millis() - timeout > 5000) {
      Serial.println(">>> Client Connection Timeout...Stopping");
      client.stop();
      return false;
    }
  }
  Serial.print("Receiving API weather data");
  while (client.available()) {
    *(resultString) = client.readStringUntil('\r');
    Serial.print(".");
  }
  Serial.println("\r\nClosing connection");
  return true;
}

bool  api_error;
const char* CurrentObservation_location_full;
const char* CurrentObservation_location_city;
const char* CurrentObservation_location_state;
const char* CurrentObservation_location_state_name;
const char* CurrentObservation_location_zip;
const char* CurrentObservation_location_country;
const char* CurrentObservation_location_country_iso3166;
const char* CurrentObservation_latitude;
const char* CurrentObservation_longitude;
const char* CurrentObservation_elevation;
const char* CurrentObservation_local_time_rfc822;
const char* CurrentObservation_observation_time;
const char* CurrentObservation_weather;
const char* CurrentObservation_temperature_string;
const char* CurrentObservation_temp_f;
const char* CurrentObservation_temp_c;
const char* CurrentObservation_dewpoint_f;
const char* CurrentObservation_dewpoint_c;
const char* CurrentObservation_heat_index_f;
const char* CurrentObservation_heat_index_c;
const char* CurrentObservation_windchill_f;
const char* CurrentObservation_windchill_c;
const char* CurrentObservation_relative_humidity;
const char* CurrentObservation_wind_string;
const char* CurrentObservation_wind_mph;
const char* CurrentObservation_wind_kph;
const char* CurrentObservation_wind_dir;
const char* CurrentObservation_wind_degrees;
const char* CurrentObservation_visibility_mi;
const char* CurrentObservation_visibility_km;
const char* CurrentObservation_pressure_mb;
const char* CurrentObservation_pressure_in;
const char* CurrentObservation_pressure_trend;
const char* CurrentObservation_precip_today_string;
const char* CurrentObservation_precip_today_in;
const char* CurrentObservation_precip_today_metric;
const char* CurrentObservation_icon;

bool  CurrCondObj(String* currCondString) {
  api_error = false;
  // When using a StaticJsonBuffer you must allocate sufficient memory for the json string returned by the WU api
  Serial.println("Creating object...");
  DynamicJsonBuffer jsonBuffer(5 * 1024);
  // Create root object and parse the json file returned from the api. The API returns errors and these need to be checked to ensure successful decoding
  JsonObject& root = jsonBuffer.parseObject(*(currCondString));
  if (root.success()) {
    Serial.println("root object created...");
    JsonObject& CurrentObservation = root["current_observation"];
    if (CurrentObservation.success()) {
      Serial.println("CurrentObservation object created...");
      // Now process the  "display_location":
      JsonObject& CurrentObservation_display_location     = CurrentObservation["display_location"]; // Set root location

      CurrentObservation_location_full            = CurrentObservation_display_location["full"];
      CurrentObservation_location_city            = CurrentObservation_display_location["city"];
      CurrentObservation_location_state           = CurrentObservation_display_location["state"];
      CurrentObservation_latitude                 = CurrentObservation_display_location["latitude"];
      CurrentObservation_longitude                = CurrentObservation_display_location["longitude"];
      CurrentObservation_elevation                = CurrentObservation_display_location["elevation"];
      CurrentObservation_location_state_name      = CurrentObservation_display_location["state_name"];
      CurrentObservation_location_country         = CurrentObservation_display_location["country"];
      CurrentObservation_location_country_iso3166 = CurrentObservation_display_location["country_iso3166"];
      CurrentObservation_location_zip             = CurrentObservation_display_location["zip"];
      CurrentObservation_local_time_rfc822        = CurrentObservation["local_time_rfc822"];
      CurrentObservation_observation_time         = CurrentObservation["observation_time"];
      CurrentObservation_weather                  = CurrentObservation["weather"];
      CurrentObservation_temperature_string       = CurrentObservation["temperature_string"];
      CurrentObservation_temp_f                   = CurrentObservation["temp_f"];
      CurrentObservation_temp_c                   = CurrentObservation["temp_c"];
      CurrentObservation_dewpoint_f               = CurrentObservation["dewpoint_f"];
      CurrentObservation_dewpoint_c               = CurrentObservation["dewpoint_c"];
      CurrentObservation_heat_index_f             = CurrentObservation["heat_index_f"];
      CurrentObservation_heat_index_c             = CurrentObservation["heat_index_c"];
      CurrentObservation_windchill_f              = CurrentObservation["windchill_f"];
      CurrentObservation_windchill_c              = CurrentObservation["windchill_c"];
      CurrentObservation_relative_humidity        = CurrentObservation["relative_humidity"];
      CurrentObservation_wind_string              = CurrentObservation["wind_string"];
      CurrentObservation_wind_mph                 = CurrentObservation["wind_mph"];
      CurrentObservation_wind_kph                 = CurrentObservation["wind_kph"];
      CurrentObservation_wind_dir                 = CurrentObservation["wind_dir"];
      CurrentObservation_wind_degrees             = CurrentObservation["wind_degrees"];
      CurrentObservation_pressure_mb              = CurrentObservation["pressure_mb"];
      CurrentObservation_pressure_in              = CurrentObservation["pressure_in"];
      CurrentObservation_pressure_trend           = CurrentObservation["pressure_trend"];
      CurrentObservation_precip_today_string      = CurrentObservation["precip_today_string"];
      CurrentObservation_precip_today_in          = CurrentObservation["precip_today_metric"];
      CurrentObservation_precip_today_metric      = CurrentObservation["precip_today_metric"];
      CurrentObservation_visibility_mi            = CurrentObservation["visibility_mi"];
      CurrentObservation_visibility_km            = CurrentObservation["visibility_km"];
      CurrentObservation_icon                     = CurrentObservation["icon"];
      return true;
    }
    else
    {
      // if the object could not be created, then return an error make an API call the next time around
      Serial.println("Unable to obtain current observation object");
      u8g2.clearBuffer();
      u8g2.setCursor(1, 30);
      u8g2.setFont(u8g2_font_profont15_mf);
      u8g2.print("Unable to obtain current observation object");
      u8g2.sendBuffer();
      api_error = true;
      return false;
    }
  }
  else
  {
    // if the root object could not be created, then return an error make an API call the next time around
    Serial.println("Unable to create a root object");
    u8g2.clearBuffer();
    u8g2.setCursor(1, 30);
    u8g2.setFont(u8g2_font_profont15_mf);
    u8g2.print("Unable to create a root object.");
    u8g2.setCursor(1, 45);
    u8g2.print("Possible cause: City unknown.");

    u8g2.sendBuffer();
    api_error = true;
    return false;
  }
}

// Functions for weather data.
String getCountry()          {
  return CurrentObservation_location_country;
}
String getCity()             {
  return CurrentObservation_location_city;
}
String getCityState()        {
  return CurrentObservation_location_full;
}
String getState()            {
  return CurrentObservation_location_state_name;
}
String getZip()              {
  return CurrentObservation_location_zip;
}
String getLatitude()         {
  return CurrentObservation_latitude;
}
String getLongitude()        {
  return CurrentObservation_longitude;
}
String getElevation()        {
  return CurrentObservation_elevation;
};
String getLocalTime()        {
  return CurrentObservation_local_time_rfc822;
}
String getObsTime()          {
  return CurrentObservation_observation_time;
}
String getCurrWeather()      {
  return CurrentObservation_weather;
}
String getCurrTempString()   {
  return CurrentObservation_temperature_string;
}
String getCurrF()            {
  return CurrentObservation_temp_f;
}
String getCurrC()            {
  return CurrentObservation_temp_c;
}
String getDewPointF()        {
  return CurrentObservation_dewpoint_f;
}
String getDewPointC()        {
  return CurrentObservation_dewpoint_c;
}
String getHeatindexF()       {
  return CurrentObservation_heat_index_f;
}
String getHeatindexC()       {
  return CurrentObservation_heat_index_c;
}
String getWindchillF()       {
  return CurrentObservation_windchill_f;
}
String getWindchillC()       {
  return CurrentObservation_windchill_c;
}
String getRelHum()           {
  return CurrentObservation_relative_humidity;
}
String getWindString()       {
  return CurrentObservation_wind_string;
}
String getWindMPH()          {
  return CurrentObservation_wind_mph;
}
String getWindKPH()          {
  return CurrentObservation_wind_kph;
}
String getWindDir()          {
  return CurrentObservation_wind_dir;
}
String getWindDegrees()      {
  return CurrentObservation_wind_degrees;
}
String getPressure_mb()      {
  return CurrentObservation_pressure_mb;
}
String getPressure_in()      {
  return CurrentObservation_pressure_in;
}
String getPressure_trend()   {
  return CurrentObservation_pressure_trend;
}
String getPrecipTodayString() {
  return CurrentObservation_precip_today_string;
}
String getPrecipTodayInches() {
  return CurrentObservation_precip_today_in;
}
String getPrecipTodayMet()   {
  return CurrentObservation_precip_today_metric;
}
String getVisibility_mi ()   {
  return CurrentObservation_visibility_mi;
}
String getVisibility_km ()   {
  return CurrentObservation_visibility_km;
}
String getWeatherIcon()      {
  return CurrentObservation_icon;
}

double readSensor(double* temperature)
{
  //holds 2 bytes of data from I2C Line
  uint8_t Byte[4];

  //holds the total contents of the temp register
  uint16_t temp;

  //holds the total contents of the humidity register
  uint16_t humidity;

  //Point to device 0x40 (Address for HDC1080)
  Wire.beginTransmission(0x40);
  //Point to register 0x00 (Temperature Register)
  Wire.write(0x00);
  //Relinquish master control of I2C line
  //pointing to the temp register triggers a conversion
  Wire.endTransmission();

  //delay to allow for sufficient conversion time
  delay(20);

  //Request four bytes from registers
  Wire.requestFrom(0x40, 4);

  delay(1);

  //If the 4 bytes were returned sucessfully
  if (4 <= Wire.available())
  {
    //take reading
    //Byte[0] holds upper byte of temp reading
    Byte[0] = Wire.read();
    //Byte[1] holds lower byte of temp reading
    Byte[1] = Wire.read();

    //Byte[3] holds upper byte of humidity reading
    Byte[3] = Wire.read();
    //Byte[4] holds lower byte of humidity reading
    Byte[4] = Wire.read();

    //Combine the two bytes to make one 16 bit int
    temp = (((unsigned int)Byte[0] << 8 | Byte[1]));

    //Temp(C) = reading/(2^16)*165(C) - 40(C)
    *temperature = (double)(temp) / (65536) * 165 - 40;

    //Combine the two bytes to make one 16 bit int
    humidity = (((unsigned int)Byte[3] << 8 | Byte[4]));

    //Humidity(%) = reading/(2^16)*100%
    return (double)(humidity) / (65536) * 100;
  }
}

void displayData()
{

  // Draw vertival separation lines
  u8g2.drawLine(92, 0, 92, 63);
  u8g2.drawLine(164, 0, 164, 63);

  u8g2.setFont(u8g2_font_logisoso16_tn);
  struct tm timeinfo;
  if (!getLocalTime(&timeinfo)) {
    Serial.println("Failed to obtain time");
    u8g2.setCursor(1, 15);
    u8g2.print("Connection to time server failed");
    u8g2.sendBuffer();
    return;
  }

  u8g2.setCursor(105, 16);
  Serial.println(&timeinfo, "%A, %B %d %Y %H:%M:%S");
  u8g2.print(&timeinfo, "%H:%M");

  //                                                               Display external readings
  u8g2.setFont(u8g2_font_profont15_mf);
  u8g2.setCursor(1, 12);
  u8g2.print("Temp:");
  u8g2.print(CurrTemp);
  if (degreesC)
    u8g2.print("C");
  else
    u8g2.print("F");

  u8g2.setCursor(1, 27);
  u8g2.print("Humd:");
  u8g2.print(CurrHumd);

  u8g2.setCursor(1, 42);
  u8g2.print("Wind:");
  u8g2.print(CurrWind);
  if (windMPH)
    u8g2.print("mph");
  else
    u8g2.print("kph");

  u8g2.setCursor(1, 57);
  u8g2.print("Pres:");
  u8g2.print(CurrPress);
  u8g2.print("hPa");

  //                                                               Display internal readings & send the values to Domoticz as well
  double temperature;
  double humidity;

  humidity = readSensor(&temperature);
  u8g2.setCursor(172, 12);
  u8g2.print("Temp:");

  if (degreesC)
  {
    u8g2.print((temperature + TempOffset), 1);
    u8g2.print("C");
  }
  else
  {
    u8g2.print((((temperature + TempOffset) * 9 / 5) + 32), 1);
    u8g2.print("F");
  }

  u8g2.setCursor(172, 27);
  u8g2.print("Humd:");
  u8g2.print((humidity + HumOffset), 0);
  u8g2.print("%");

  if (!ccs.readData()) {
    u8g2.setCursor(172, 42);
    u8g2.print("CO2:");
    CO2 = (ccs.geteCO2());
    u8g2.print(CO2);
    u8g2.print("ppm");

    u8g2.setCursor(172, 57);
    u8g2.print("VOC:");
    TVOC = (ccs.getTVOC());
    u8g2.print(ccs.getTVOC());
    u8g2.print("ppb");

if (client.connect(domoticz_server,port)) {
  
    client.print("GET /json.htm?type=command&param=udevice&idx=");
    client.print(idx1);
    client.print("&nvalue=0&svalue=");
    client.print((temperature + TempOffset), 1);
    client.print(";");
    client.print((humidity + HumOffset), 0);;
    client.print(";0"); //Value for HUM_STAT. Can be one of: 0=Normal, 1=Comfortable, 2=Dry, 3=Wet
    client.print("GET /json.htm?type=command&param=udevice&idx="); // Change idx to Co2 Sensor idx
    client.print(idx2);
    client.print("&nvalue=0&svalue=");
    client.print(CO2);
    client.print("GET /json.htm?type=command&param=udevice&idx="); // Change idx to Co2 Sensor idx
    client.print(idx3);
    client.print("&nvalue=0&svalue=");
    client.print(TVOC);; 
    client.println(" HTTP/1.1");
    client.print("Host: ");
    client.print(domoticz_server);
    client.print(":");
    client.println(port);
    client.println("User-Agent: esp32-weatherstation");
    client.println("Connection: close");
    client.println();

    client.stop();
    }
    
    if (CO2 > CO2Trigger)
    {
      CO2Alarm();
    }

    if (TVOC > TVOCTrigger)
    {
      TVOCAlarm();
    }
  }
  delay(100);
}

void CO2Alarm()
{

  if (returnAfterAlarm) // If the returnAfterAlarm = true, Do this and return

  {
    u8g2.clearBuffer();
    u8g2.setFont(u8g2_font_inb30_mr);
    u8g2.setCursor(5, 45);
    u8g2.print("CO2 ALARM");
    u8g2.sendBuffer();
    digitalWrite(buzzerPin, HIGH);
    delay(500);
    u8g2.clearBuffer();
    u8g2.sendBuffer();
    digitalWrite(buzzerPin, LOW);
    delay(500);
  }

  else // If the returnAfterAlarm = false, Do this for ever
  {
    while (1)
    {
      u8g2.clearBuffer();
      u8g2.setFont(u8g2_font_inb30_mr);
      u8g2.setCursor(5, 45);
      u8g2.print("CO2 ALARM");
      u8g2.sendBuffer();
      digitalWrite(buzzerPin, HIGH);
      delay(500);
      u8g2.clearBuffer();
      u8g2.sendBuffer();
      delay(500);
    }
  }
}

void TVOCAlarm()
{
  if (returnAfterAlarm) // If the returnAfterAlarm = true, Do this and return
  {
    u8g2.clearBuffer();
    u8g2.setFont(u8g2_font_inb30_mr);
    u8g2.setCursor(5, 45);
    u8g2.print("VOC ALARM");
    u8g2.sendBuffer();
    digitalWrite(buzzerPin, HIGH);
    delay(500);
    u8g2.clearBuffer();
    u8g2.sendBuffer();
    digitalWrite(buzzerPin, LOW);
    delay(500);

  }
  else // If the returnAfterAlarm = false, Do this for ever
  {
    while (1)
    {
      u8g2.clearBuffer();
      u8g2.setFont(u8g2_font_inb30_mr);
      u8g2.setCursor(5, 45);
      u8g2.print("VOC ALARM");
      u8g2.sendBuffer();
      digitalWrite(buzzerPin, HIGH);
      delay(500);
      u8g2.clearBuffer();
      u8g2.sendBuffer();
      digitalWrite(buzzerPin, LOW);
      delay(500);
    }
  }
}
/*
 void printInfo()
{
// Domoticz format /json.htm?type=command&param=udevice&idx=IDX&nvalue=0&svalue=TEMP;HUM;HUM_STAT

if (client.connect(domoticz_server,port)) {
  
    client.print("GET /json.htm?type=command&param=udevice&idx=");
    client.print(idx1);
    client.print("&nvalue=0&svalue=");
    client.print((temperature + TempOffset), 1);
    client.print(";");
    client.print(humidity);
    client.print(";0"); //Value for HUM_STAT. Can be one of: 0=Normal, 1=Comfortable, 2=Dry, 3=Wet
    client.print("GET /json.htm?type=command&param=udevice&idx="); // Change idx to Co2 Sensor idx
    client.print(idx2);
    client.print("&nvalue=0&svalue=");
    client.print(CO2);
    client.print("GET /json.htm?type=command&param=udevice&idx="); // Change idx to Co2 Sensor idx
    client.print(idx3);
    client.print("&nvalue=0&svalue=");
    client.print(TVOC);; 
    client.println(" HTTP/1.1");
    client.print("Host: ");
    client.print(domoticz_server);
    client.print(":");
    client.println(port);
    client.println("User-Agent: Arduino-ethernet");
    client.println("Connection: close");
    client.println();

    client.stop();
    }
}
*/
